## board/msc/common/Kconfig
```kconfig
#
# Copyright (C) 2023 AVNET Embedded
#
# SPDX-License-Identifier:      GPL-2.0+
#

menu "MSC board/module specific features"

config BOARDINFO_EEPROM
	bool "Board information EEPROM storage"
	default y
	help
	  Enable board information storage in EEPROM

config SPL_BOARDINFO_EEPROM
	bool "BOARDINFO in SPL"
	depends on SPL && BOARDINFO_EEPROM
	default y
	help
		Enable this if the SPL needs boardinfo

config DECODE_FEATURE
	bool
	default y if BOARDINFO_EEPROM

if BOARDINFO_EEPROM

config CMD_BOARDINFO
	bool "Enable the 'boardinfo' command"
	help
	  Provides access to the board infromations like
	  boardname, serial number, etc

endif

config CMD_FDTLOAD
	bool "Provides MSC's 'fdtload' command"
	default n
	help
	  This command supports loading a bunch of devicetree and merging them into one.

config SPL_CMD_FDTLOAD
	bool "FDTLOAD in SPL"
	depends on SPL && CMD_FDTLOAD
	default y
	help
		Enable this if the SPL needs fdtload

endmenu
```

## board/msc/sm2s_am62x/Kconfig
```kconfig
# SPDX-License-Identifier: GPL-2.0+
#
# Copyright (C) 2023 AVNET Embedded, MSC Technologies GmbH
#

choice
	prompt "MSC SM2S AM62x based boards"
	optional

config TARGET_SM2S_AM625_A53
	bool "MSC SM2S AM62x based boards running on A53"
	select ARM64
	select BINMAN

config TARGET_SM2S_AM625_R5
	bool "MSC SM2S AM62x based boards running on R5"
	select CPU_V7R
	select SYS_THUMB_BUILD
	select K3_LOAD_SYSFW
	select RAM
	select SPL_RAM
	select K3_DDRSS
	select BINMAN
	imply SYS_K3_SPL_ATF

endchoice

if TARGET_SM2S_AM625_A53

config SYS_BOARD
       default "sm2s_am62x"

config SYS_VENDOR
       default "msc"

config SYS_CONFIG_NAME
       default "msc_sm2s_am62x"

source "board/ti/common/Kconfig"

source "board/msc/common/Kconfig"

endif

if TARGET_SM2S_AM625_R5

config SYS_BOARD
       default "sm2s_am62x"

config SYS_VENDOR
       default "msc"

config SYS_CONFIG_NAME
       default "msc_sm2s_am62x"

config SPL_LDSCRIPT
	default "arch/arm/mach-omap2/u-boot-spl.lds"

source "board/ti/common/Kconfig"

source "board/msc/common/Kconfig"

endif
```
